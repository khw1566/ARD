## ARD_ESP-IDF/ControlMCU/main/Kconfig.projbuild
```kconfig
menu "ARD ControlMCU"

    config CONTROL_DEFAULT_SERVER
        string "Default PC server host"
        default "10.115.5.12"
        help
            IPv4, DNS name or name.local of the PC running the ARD server (port 5000).
            Used until a server is saved on the board's /network settings page.

    config CONTROL_DEFAULT_VOLUME
        int "Volume before one is saved (0-21)"
        range 0 21
        default 12

    config CONTROL_PREBUFFER_MS
        int "Voice jitter buffer before playback starts (ms)"
        range 0 300
        default 96
        help
            The PC sends 32 ms PCM packets. Waiting for a few of them before the
            first sample absorbs Wi-Fi jitter; the Arduino build played each packet
            as it arrived and clicked whenever one was late.

    config CONTROL_BOOT_MELODY
        bool "Play the boot melody"
        default y

endmenu
```

## ARD_ESP-IDF/DriveMCU/main/Kconfig.projbuild
```kconfig
menu "ARD DriveMCU"

    config ARD_ENABLE_TOF
        bool "Enable VL53L0X ToF sensor"
        default y
        help
            The Z rail is ToF PID controlled again (2026-10-26). Without the sensor the rail
            runs open loop and mzm1 is rejected.

    config ARD_ENABLE_RAIL_PID
        bool "Allow ToF rail PID (mzm1)"
        depends on ARD_ENABLE_TOF
        default y
        help
            The rail was open loop from 2026-10-16 and returns to the ToF PID on 2026-10-26.
            When off, mzm1 is rejected and only the PID parameters are stored.

    config ARD_DISK_MAX_SPEED
        int "Disc (X/Y) max speed, steps/s"
        range 50 1000
        default 300
        help
            Default and upper cap for mxs/mys and the X/Y jog (2026-10-27: lowered from 500
            against disc overshoot and missed steps).

    config ARD_DISK_ACCEL
        int "Disc (X/Y) acceleration, steps/s^2"
        range 50 2000
        default 300

    config ARD_DISK_TILT_LIMIT_DEG
        int "Disc tilt safety limit, degrees"
        range 5 90
        default 60
        help
            Tilt = (X - Y) / 2 motor steps through the reducer. Every X/Y move, jog and
            homing keeps the tilt within +-this. Disc rotation (X + Y) is not limited.

    config ARD_DISK_GEAR_RATIO
        int "Disc reducer ratio (motor turns per bevel input turn)"
        range 1 100
        default 4

    config ARD_DEFAULT_SERVER
        string "Default PC server host"
        default "192.168.0.35"
        help
            Used until a server is saved from the setup portal (/network).

endmenu
```

## ARD_ESP-IDF/HMI_MCU/main/Kconfig.projbuild
```kconfig
menu "ARD HMI"

    config HMI_DEFAULT_SERVER
        string "Default PC server host"
        default "192.168.0.35"
        help
            IPv4, DNS name or name.local of the PC running the ARD server (port 5000).
            Used until a server is saved on the board's /network settings page.

    config HMI_STATUS_POLL_MS
        int "Status poll interval (ms)"
        range 500 30000
        default 3000

    config HMI_LCD_INVERT
        bool "Invert panel colours (INVON)"
        default y
        help
            The ESP32-2432S028 ILI9341 panel needs inversion; the Arduino build
            called tft.invertDisplay(true).

    config HMI_Z_STEP_BUTTONS
        bool "Enable OpenLoop Z step +/- buttons"
        default n
        help
            The PC server forwards "mzs+N" to DriveMCU, and DriveMCU treats any
            "mzs<value>" as a new Z steps/mm calibration. Leave this off until the
            server stops forwarding the step command.

    config HMI_RAIL_PID
        bool "Enable ToF rail PID buttons (PID on/off, target)"
        default n
        help
            ToF-based Z rail PID control is locked for now. When off, the Z Rail
            page shows ToF and the current mode read-only and keeps only HOME.

endmenu
```

## ARD_ESP-IDF/HMI_MCU/test/sim/sdkconfig.defaults
```kconfig
CONFIG_IDF_TARGET="esp32"
CONFIG_ESPTOOLPY_FLASHSIZE_4MB=y
CONFIG_PARTITION_TABLE_SINGLE_APP_LARGE=y
CONFIG_COMPILER_OPTIMIZATION_PERF=y
CONFIG_ESP_MAIN_TASK_STACK_SIZE=8192
CONFIG_LOG_DEFAULT_LEVEL_WARN=y
CONFIG_ESP_TASK_WDT_INIT=n
```

## ARD_ESP-IDF/JC1060P470C/main/Kconfig.projbuild
```kconfig
menu "ARD JC1060P470C"

    menu "Onboard microphone and speaker (ES8311)"
        config ARD_VOICE_MCLK
            int "I2S MCLK GPIO"
            range 0 54
            default 13
        config ARD_VOICE_BCLK
            int "I2S BCLK GPIO"
            range 0 54
            default 12
        config ARD_VOICE_WS
            int "I2S LRCK GPIO"
            range 0 54
            default 10
        config ARD_VOICE_DOUT
            int "I2S speaker data GPIO"
            range 0 54
            default 9
        config ARD_VOICE_DIN
            int "I2S microphone data GPIO"
            range 0 54
            default 48
        config ARD_VOICE_MIC_SLOT
            int "ES8311 microphone slot (0 = left, 1 = right)"
            range 0 1
            default 0
        config ARD_VOICE_MIC_GAIN_DB
            int "Microphone analog gain (dB)"
            range 0 42
            default 24
        config ARD_VOICE_MAX_SECONDS
            int "Maximum utterance length (seconds, bounded PSRAM buffer)"
            range 3 20
            default 15
    endmenu

    menu "Display panel"
        choice ARD_PANEL_VARIANT
            prompt "JC1060P470C panel revision"
            default ARD_PANEL_V2
            help
                Both use the JD9165 driver but a different glass and init table.
                A "V2" printed after the material number on the rear label means V2.
                Wrong choice: white screen or a vertical noise band (see README).

            config ARD_PANEL_V1
                bool "V1 (no V2 mark on the label)"
            config ARD_PANEL_V2
                bool "V2 (2026 batch, 'V2' on the label)"
        endchoice

        config ARD_PIN_LCD_RST
            int "LCD reset GPIO (-1 = none)"
            default 0
            help
                GPIO0 per the JC1060P470C_I_W_Y schematic as quoted by the ESPHome board profiles.
                UNVERIFIED on a real board.

        config ARD_PIN_BACKLIGHT
            int "Backlight PWM GPIO"
            default 23

        config ARD_BACKLIGHT_ACTIVE_LOW
            bool "Backlight PWM is inverted"
            default n
            help
                Community configs disagree (one inverts GPIO23, one does not). If the screen is
                dark at high brightness and bright at low, flip this.

        config ARD_TOUCH_SWAP_XY
            bool "Touch: swap X/Y"
            default n
        config ARD_TOUCH_MIRROR_X
            bool "Touch: mirror X"
            default n
        config ARD_TOUCH_MIRROR_Y
            bool "Touch: mirror Y"
            default n
    endmenu

    menu "Expansion header pins (motors, buzzer, GPS)"
        comment "Defaults use the 2x13 header GPIOs; check them against your wiring."

        config ARD_PIN_STEP_X
            int "X STEP"
            default 32
        config ARD_PIN_DIR_X
            int "X DIR"
            default 33
        config ARD_PIN_STEP_Y
            int "Y STEP"
            default 45
        config ARD_PIN_DIR_Y
            int "Y DIR"
            default 46
        config ARD_PIN_STEP_Z
            int "Z (rail) STEP"
            default 47
        config ARD_PIN_DIR_Z
            int "Z (rail) DIR"
            default 20
        config ARD_PIN_EN_X
            int "X EN (active low). Also drives Y/Z when their EN is -1"
            default 1
        config ARD_PIN_EN_Y
            int "Y EN (-1 = shared with X EN)"
            default -1
        config ARD_PIN_EN_Z
            int "Z EN (-1 = shared with X EN)"
            default -1
        config ARD_PIN_BUZZER
            int "Passive buzzer (-1 = none)"
            default 2
        config ARD_PIN_GPS_RX
            int "GPS RX (board input, from GPS TX) (-1 = no GPS)"
            default 3
        config ARD_PIN_GPS_TX
            int "GPS TX (board output, to GPS RX)"
            default 4
    endmenu

    config ARD_ENABLE_TOF
        bool "Enable VL53L0X ToF sensor (rail PID)"
        default n
        help
            Same default as DriveMCU: the rail runs open loop and mzm1 is rejected.

    config ARD_DEFAULT_SERVER
        string "Default PC server host"
        default "192.168.0.35"
        help
            Used until a server is saved from the setup portal (/network).

    config ARD_ENABLE_GAMEPAD
        bool "BLE HID gamepad over the ESP32-C6"
        default y
        depends on BT_NIMBLE_ENABLED
        help
            Uses the C6 Bluetooth controller through ESP-Hosted (VHCI) with the NimBLE host on the P4.

endmenu
```
